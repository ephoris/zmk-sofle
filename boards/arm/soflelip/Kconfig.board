## boards/arm/soflelip/Kconfig.board
```kconfig
#
# Copyright (c) 2024 The ZMK Contributors
# SPDX-License-Identifier: MIT
#

config BOARD_SOFLELIP_LEFT
    bool "soflelip left"
    depends on SOC_NRF52840_QIAA

config BOARD_SOFLELIP_RIGHT
    bool "soflelip right"
    depends on SOC_NRF52840_QIAA
```
